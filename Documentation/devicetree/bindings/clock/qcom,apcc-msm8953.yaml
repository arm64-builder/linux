## Documentation/devicetree/bindings/clock/qcom,apcc-msm8953.yaml
```yaml
# SPDX-License-Identifier: (GPL-2.0-only OR BSD-2-Clause)
%YAML 1.2
---
$id: http://devicetree.org/schemas/clock/qcom,apcc-msm8953.yaml#
$schema: http://devicetree.org/meta-schemas/core.yaml#

title: Qualcomm Application Processor Clock Controller Bindings for MSM8953

maintainers:
  - Vladimir Lypak <vladimir.lypak@gmail.com>

description: |
  Bindings for Qualcomm Application Processor Clock Controller on MSM8953
  and SDM632.

  See also:
  - dt-bindings/clock/qcom,apcc-msm8953.h

properties:
  compatible:
    enum:
      - qcom,apcc-msm8953
      - qcom,apcc-sdm632

  '#clock-cells':
    const: 1

  clocks:
    items:
      - description: Clock source for PLL
      - description: Clock source which is used while PLL is changing rate.

  clock-names:
    items:
      - const: xo
      - const: safe_src

  reg:
    maxItems: 1

  protected-clocks:
    description:
      Protected clock specifier list as per common clock binding.

required:
  - reg
  - '#clock-cells'
  - clocks
  - clock-names

additionalProperties: false

examples:
  - |
      #include <dt-bindings/clock/qcom,apcc-msm8953.h>

      apcc: clock-controller@b011050 {
        compatible = "qcom,apcc-msm8953";
        reg = <0xb011050 0x1c0050>;

        clocks = <&xo_board>, <&gcc GPLL0_EARLY>;
        clock-names = "xo", "safe_src";

        #clock-cells = <1>;
      };
```
